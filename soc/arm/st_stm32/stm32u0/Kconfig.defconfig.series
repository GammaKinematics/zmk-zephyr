## soc/arm/st_stm32/stm32u0/Kconfig.defconfig.series
```kconfig
# ST Microelectronics STM32U0 MCU line

# Copyright (c) 2021 Linaro Limited
# SPDX-License-Identifier: Apache-2.0

if SOC_SERIES_STM32U0X

source "soc/arm/st_stm32/stm32u0/Kconfig.defconfig.stm32u0*"

config SOC_SERIES
	default "stm32u0"

config ROM_START_OFFSET
	default 0x400 if BOOTLOADER_MCUBOOT

endif # SOC_SERIES_STM32U0X
```

## soc/arm/st_stm32/stm32u0/Kconfig.defconfig.stm32u031xx
```kconfig
# STMicroelectronics STM32U031XX MCU

# Copyright (c) 2024 STMicroelectronics
# SPDX-License-Identifier: Apache-2.0

if SOC_STM32U031XX

config SOC
	default "stm32u031xx"

config NUM_IRQS
	default 32

endif # SOC_STM32U031XX
```

## soc/arm/st_stm32/stm32u0/Kconfig.defconfig.stm32u073xx
```kconfig
# STMicroelectronics STM32U073XX MCU

# Copyright (c) 2024 STMicroelectronics
# SPDX-License-Identifier: Apache-2.0

if SOC_STM32U073XX

config SOC
	default "stm32u073xx"

config NUM_IRQS
	default 32

endif # SOC_STM32U073XX
```

## soc/arm/st_stm32/stm32u0/Kconfig.series
```kconfig
# ST Microelectronics STM32U0 MCU series

# Copyright (c) 2021 Linaro Limited
# SPDX-License-Identifier: Apache-2.0

# Based on stm32u5/Kconfig.series
config SOC_SERIES_STM32U0X
	bool "STM32U0x Series MCU"
	select ARM
	select CPU_CORTEX_M0PLUS        # Changed from M33
	select SOC_FAMILY_STM32
	select CPU_HAS_ARM_MPU          # No TrustZone/SAU for M0+
	select CPU_CORTEX_M_HAS_VTOR
	select CPU_CORTEX_M_HAS_SYSTICK
	select HAS_STM32CUBE
	help
	  Enable support for STM32U0 MCU series
```

## soc/arm/st_stm32/stm32u0x/Kconfig.series
```kconfig
# ST Microelectronics STM32U0 MCU series
# Copyright (c) 2024 STMicroelectronics
# SPDX-License-Identifier: Apache-2.0

config SOC_SERIES_STM32U0X
	bool "STM32U0x Series MCU"
	select ARM
	select CPU_CORTEX_M0PLUS
	select CPU_CORTEX_M_HAS_VTOR
	select CPU_HAS_ARM_MPU
	select SOC_FAMILY_STM32
	select HAS_STM32CUBE
	select CPU_CORTEX_M_HAS_SYSTICK
	help
	  Enable support for STM32U0 MCU series
```

## soc/arm/st_stm32/stm32u0x/Kconfig.soc
```kconfig
# ST Microelectronics STM32U0 MCU line
# Copyright (c) 2024 STMicroelectronics
# SPDX-License-Identifier: Apache-2.0

choice
	prompt "STM32U0x MCU Selection"
	depends on SOC_SERIES_STM32U0X

config SOC_STM32U031XX
	bool "STM32U031XX"

config SOC_STM32U073XX
	bool "STM32U073XX"

config SOC_STM32U083XX
	bool "STM32U083XX"

endchoice
```

## soc/st/stm32/Kconfig
```kconfig
# Copyright (c) 2024 STMicroelectronics
# SPDX-License-Identifier: Apache-2.0

config SOC_FAMILY_STM32
	bool

if SOC_FAMILY_STM32

rsource "*/Kconfig"

config HAS_STM32CUBE
	bool
	default y

endif # SOC_FAMILY_STM32
```
